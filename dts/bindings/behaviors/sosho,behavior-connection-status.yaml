## dts/bindings/behaviors/sosho,behavior-connection-status.yaml
```yaml
description: Show the active host connection on the central keyboard half
compatible: "sosho,behavior-connection-status"
include: zero_param.yaml
```

## dts/bindings/behaviors/sosho,behavior-encoder-mouse-scroll.yaml
```yaml
description: One-shot encoder scrolling with an independent scroll multiplier

compatible: "sosho,behavior-encoder-mouse-scroll"

properties:
  "#sensor-binding-cells":
    type: int
    required: true
    const: 2
  scroll-multiplier:
    type: int
    default: 1
    description: Scroll units sent per encoder trigger

sensor-binding-cells:
  - param1
  - param2
```

## dts/bindings/behaviors/sosho,behavior-profile-status.yaml
```yaml
description: Show the state of a Bluetooth profile without selecting it
compatible: "sosho,behavior-profile-status"
include: one_param.yaml
```
